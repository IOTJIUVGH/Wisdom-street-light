#include "24c32.h"
#include "delay.h"
u8 g_MACAddr[240]={0x88,0x49,0x77,0x42,0x99,0x11,
									 0x34,0x72,0x12,0x45,0x24,0x11,
									 0x76,0x31,0x52,0x62,0x48,0x11,	
									 0x94,0x03,0x32,0x07,0x08,0x11,
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									 0x13,0x48,0x71,0x41,0x87,0x11,
	//
									 0x36,0x62,0x73,0x68,0x47,0x11,
									 0x04,0x22,0x53,0x89,0x51,0x11,
									 0x54,0x68,0x52,0x37,0x04,0x11,
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									 0x13,0x48,0x27,0x40,0x55,0x11,
									 //0x22,0x70,0x88,0x41,0x20,0x11,
									 
								   0x33,0x25,0x10,0x51,0x20,0x11,
									 0x75,0x15,0x94,0x31,0x88,0x11,
									 0x09,0x24,0x19,0x92,0x39,0x11,
									 0x49,0x27,0x98,0x54,0x96,0x11,
									 0x08,0x57,0x61,0x59,0x67,0x11};

u8 MACList[250]={0};
static u16 MAC_Num;
u16 MAC_NumL;

void en_24c32()
{
	RCC->APB2ENR |= (0X0001 << 3) ;  //开启GPIOB时钟
	GPIOB->CRL &= 0xFF0FFFFF;  //WP  24C64
	GPIOB->CRL |= 0x00300000;
	GPIOB->BSRR |= 0X00200000;
}

void write_byte(u16 ADDRESS, u8 dat)
{
	
	IIC_Start();  //起始信号
	IIC_Send_Byte(0xa2);  //写设备地址，写标志位
	while(!(IIC_Wait_Ack_24c32()));  

	IIC_Send_Byte(ADDRESS >> 8);  //地址高位
	while(!(IIC_Wait_Ack_24c32()));  
	
	IIC_Send_Byte(ADDRESS);       //地址地位
	while(!(IIC_Wait_Ack_24c32()));  
	
	IIC_Send_Byte(dat);           //写数据
	while(!(IIC_Wait_Ack_24c32()));  

	IIC_Stop();

}

void write_page(u16 ADDRESS, u8 *dat, u8 num)
{
	u8 i;
	
	IIC_Start();  //起始信号
	IIC_Send_Byte(0xa2);  //写设备地址，写标志位
	while(!(IIC_Wait_Ack_24c32())); 
	IIC_Send_Byte(ADDRESS >> 8);  //地址高位
	while(!(IIC_Wait_Ack_24c32())); 
	IIC_Send_Byte(ADDRESS);       //地址地位
	while(!(IIC_Wait_Ack_24c32())); 
	
	for(i=0; i<num; i++)
	{
		IIC_Send_Byte(dat[i]);           //写数据
		while(!(IIC_Wait_Ack_24c32())); 
	}

	IIC_Stop();
}

void Read_CurAddr() 
{
	u8 dat;
	
	IIC_Start();

	IIC_Send_Byte(0xa3);
	while((IIC_Wait_Ack()));

	dat = IIC_Read_Byte(1);
	while((IIC_Wait_Ack()));

	IIC_Stop();
	
	printf("%x,",dat);
}

u8 Read_RanAddr(u16 ADDRESS) 
{
	u8 dat;
	
	IIC_Start();  //起始信号
	IIC_Send_Byte(0xa2);  //写设备地址，写标志位
	while(!(IIC_Wait_Ack_24c32()));  
	IIC_Send_Byte(ADDRESS >> 8);  //地址高位
	while(!(IIC_Wait_Ack_24c32()));  
	IIC_Send_Byte(ADDRESS);       //地址地位
	while(!(IIC_Wait_Ack_24c32()));  
	
	IIC_Start();  //起始信号
	IIC_Send_Byte(0xa3);
	while(!(IIC_Wait_Ack_24c32()));  

	dat = IIC_Read_Byte(0);

	IIC_Stop();
	
	return dat;
	//printf("%x,",dat);
}

void Read_Seq(u16 ADDRESS, u8 num) 
{
	u8 i;
	//u8 dat[32];
	
	IIC_Start();  //起始信号
	IIC_Send_Byte(0xa2);  //写设备地址，写标志位
	while(!(IIC_Wait_Ack_24c32()));  
	IIC_Send_Byte(ADDRESS >> 8);  //地址高位
	while(!(IIC_Wait_Ack_24c32())); 
	IIC_Send_Byte(ADDRESS);       //地址地位
	while(!(IIC_Wait_Ack_24c32())); 
	
	IIC_Start();  //起始信号
	IIC_Send_Byte(0xa3);
	while(!(IIC_Wait_Ack_24c32())); 

	for(i=0; i<=num; i++)
	{
		if(i==num)
			MACList[MAC_Num] = IIC_Read_Byte(0);
		MACList[MAC_Num]= IIC_Read_Byte(1);
		MAC_Num++;
	}

	IIC_Stop();
	//return dat;
}

void Storage_MACAddr(u8 *data,u16 len)
{
	u8 i=0,j,Page_Num;
	
	Page_Num=len/32;
	j=len%32;
	
	for(i=0;i<Page_Num;i++)
	{
		write_page(i*32,data,32);
		data=data+32;
		Delayms(50);
	}
	if(j!=0)
	{
		write_page(i*32,data,j);
	}
}

void Read_MACAddr(u16 addr,u16 len)
{
	u8 i=0,j,Page_Num;
	
	MAC_Num=0;
	Page_Num=len/32;
	j=len%32;
	
	for(i=0;i<Page_Num;i++)
	{
		Read_Seq(addr+i*32,32);
		MAC_Num--;
	}
	if(j!=0)
	{
		Read_Seq(i*32,j);
	}
	//printf("GO");
	MAC_NumL=MAC_Num;
	
}
